AUTOSAR XML (schema 00050)
package /RB/AdaptiveDemoManifest
  adaptive application sw component type server_app
    provide port pp_Method: provided-interface=Method
