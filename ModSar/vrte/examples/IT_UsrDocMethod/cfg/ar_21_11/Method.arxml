AUTOSAR XML (schema 00050)
package /RB/AdaptiveDemoManifest
  service interface Method
    namespaces:
      4 x symbol props:
        com_1: symbol=com
        bosch_2: symbol=bosch
        vrte_3: symbol=vrte
        method_4: symbol=method
    methods:
      operation MethodIO
        arg m_value_in: type=MsgRequest, direction=IN
        arg m_value_out: type=MsgResponse, direction=OUT
        arg m_res_out: type=bool, direction=OUT
  4 x std cpp implementation data type:
    MethodRequestStruct: category=STRUCTURE
      cpp implementation data type element value_one: type-reference={inplace=true, type-reference=MethodRequestStruct_value_one_array}
      cpp implementation data type element value_two: type-reference=bool
      cpp implementation data type element value_three: type-reference=uint32_t
    MethodRequestStruct_value_one_array: category=ARRAY, array-size=3, cpp-template-argument=uint16_t
    MsgRequest: type-reference=MethodRequestStruct
    MsgResponse: category=ARRAY, array-size=5, cpp-template-argument=uint8_t
