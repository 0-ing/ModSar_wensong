AUTOSAR XML (schema 00050)
package /RB/VRTE/ServiceInstanceToMachineMappings
  someip service instance to machine mapping Machine_IT_UsrDoc_FS1_SSITMM_1: communication-connector=Machine_IT_UsrDoc_FS1_ECC, service-instance=Machine_IT_UsrDocMethod_FS1_PSSI, udp-port=Machine_IT_UsrDoc_FS1_SSITMM_udpPort_5000
  someip service instance to machine mapping Machine_IT_UsrDoc_FS2_SSITMM_1: communication-connector=Machine_IT_UsrDoc_FS2_ECC, service-instance=Machine_IT_UsrDocMethod_FS2_RSSI, udp-port=Machine_IT_UsrDoc_FS2_SSITMM_udpPort_6000
package /RB/VRTE/ServiceInstances
  provided someip service instance Machine_IT_UsrDocMethod_FS1_PSSI: service-interface-deployment=Machine_IT_UsrDocMethod_Publisher_SSID, sd-server-config=Machine_IT_UsrDoc_FS1_SSDSSIC_1, service-instance-id=34343
  required someip service instance Machine_IT_UsrDocMethod_FS2_RSSI: service-interface-deployment=Machine_IT_UsrDocMethod_Publisher_SSID, required-service-instance-id=34343, sd-client-config=Machine_IT_UsrDoc_FS2_SSDCSIC_1
package /RB/VRTE/ServiceInterfaceDeployments
  someip service interface deployment Machine_IT_UsrDocMethod_Publisher_SSID: service-interface=Method, service-interface-id=11, service-interface-version={major-version=1, minor-version=0}
    someip method deployment MethodIO: method=MethodIO, method-id=1, transport-protocol=UDP
package /RB/VRTE/SomeipSdTimingConfigs
  someip sd server service instance config Machine_IT_UsrDoc_FS1_SSDSSIC_1: initial-offer-behavior={initial-delay-max-value=0.1, initial-delay-min-value=0.01, initial-repetitions-base-delay=0.04, initial-repetitions-max=1}, request-response-delay={max-value=1.5, min-value=1.5}, service-offer-time-to-live=10
  someip sd client service instance config Machine_IT_UsrDoc_FS2_SSDCSIC_1: initial-find-behavior={initial-delay-max-value=0.1, initial-delay-min-value=0.01, initial-repetitions-base-delay=0.04, initial-repetitions-max=1}, service-find-time-to-live=10
