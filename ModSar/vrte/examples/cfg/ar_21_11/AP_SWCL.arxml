AUTOSAR XML (schema 00050)
package /bosch/SWCL
  software cluster SWCL_1: category=PLATFORM_CORE  # ARPath /bosch/SWCL/SWCL_1
  software package SWP_1: software-cluster=SWCL_1  # ARPath /bosch/SWCL/SWP_1
