AUTOSAR XML (schema 00050)
package /RB/VRTE/CommunicationClusters
  ethernet cluster Machine_IT_UsrDoc_FS1_EthernetCluster
    ethernet physical channel Machine_IT_UsrDoc_FS1_PhysicalChannel
      network endpoint Machine_IT_UsrDoc_FS1_Multicast: network-endpoint-addresses=ipv-4-configuration={ipv-4-address=224.244.224.245, ipv-4-address-source=FIXED}
      network endpoint Machine_IT_UsrDoc_FS1_NetworkEndpoint: network-endpoint-addresses=ipv-4-configuration={ipv-4-address=192.168.111.20, ipv-4-address-source=FIXED}
package /RB/VRTE/MachineDesigns
  machine design Machine_IT_UsrDoc_FS1: service-discovery-configs=someip-service-discovery={multicast-sd-ip-address=Machine_IT_UsrDoc_FS1_Multicast, someip-service-discovery-port=30490}
    ethernet communication connector Machine_IT_UsrDoc_FS1_ECC: network-endpoint=Machine_IT_UsrDoc_FS1_Multicast, unicast-network-endpoint=Machine_IT_UsrDoc_FS1_NetworkEndpoint
      ap application endpoint Machine_IT_UsrDoc_FS1_SSITMM_udpPort_5000: tp-configuration=udp-tp=udp-tp-port=port-number=5000
package /RB/VRTE/Machines
  machine Machine: machine-design=Machine_IT_UsrDoc_FS1
