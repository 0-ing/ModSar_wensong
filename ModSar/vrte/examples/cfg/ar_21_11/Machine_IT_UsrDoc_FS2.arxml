AUTOSAR XML (schema 00050)
package /RB/VRTE/CommunicationClusters
  ethernet cluster Machine_IT_UsrDoc_FS2_EthernetCluster
    ethernet physical channel Machine_IT_UsrDoc_FS2_PhysicalChannel
      network endpoint Machine_IT_UsrDoc_FS2_Multicast: network-endpoint-addresses=ipv-4-configuration={ipv-4-address=224.244.224.245, ipv-4-address-source=FIXED}
      network endpoint Machine_IT_UsrDoc_FS2_NetworkEndpoint: network-endpoint-addresses=ipv-4-configuration={ipv-4-address=192.168.111.21, ipv-4-address-source=FIXED}
package /RB/VRTE/MachineDesigns
  machine design Machine_IT_UsrDoc_FS2: service-discovery-configs=someip-service-discovery={multicast-sd-ip-address=Machine_IT_UsrDoc_FS2_Multicast, someip-service-discovery-port=30490}
    ethernet communication connector Machine_IT_UsrDoc_FS2_ECC: network-endpoint=Machine_IT_UsrDoc_FS2_Multicast, unicast-network-endpoint=Machine_IT_UsrDoc_FS2_NetworkEndpoint
      ap application endpoint Machine_IT_UsrDoc_FS2_SSITMM_udpPort_6000: tp-configuration=udp-tp=udp-tp-port=port-number=6000
package /RB/VRTE/Machines
  machine Machine_1: machine-design=Machine_IT_UsrDoc_FS2
