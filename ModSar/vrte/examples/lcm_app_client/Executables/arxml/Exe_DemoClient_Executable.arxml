AUTOSAR XML (schema 00049)
package /RB/Pt/Platform/PA3/Executables
  executable Exe_DemoClient: reporting-behavior=REPORTS-EXECUTION-STATE, version=1.0.0.0
    root sw component prototype Exe_DemoClient_RootSwComponent: application-type=DemoClient
