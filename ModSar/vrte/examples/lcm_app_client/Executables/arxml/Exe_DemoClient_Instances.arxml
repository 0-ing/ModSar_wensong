AUTOSAR XML (schema 00050)
package /RB/Pt/Platform/PA3/Processes
  process Proc_Exe_DemoClient: design=Proc_Exe_DemoClient_PD, executable=Exe_DemoClient, state-dependent-startup-config=Proc_Exe_DemoClient_StartupConfig
package /RB/Pt/Platform/PA3/StartupConfigSets
  startup config set Proc_Exe_DemoClient_StartupConfigSet
package /RB/Pt/Platform/PA3/ProcessToMachineMappings
  process to machine mapping set Exe_DemoClient_Instances_ProcessToMachineMappingSet
    process to machine mapping Proc_Exe_DemoClient_FlexibleSafety_Mapping: machine=FlexibleSafety, process=Proc_Exe_DemoClient
package /RB/VRTE/ServiceInstanceToPortPrototypeMappings
  process design Proc_Exe_DemoClient_PD: executable=Exe_DemoClient
