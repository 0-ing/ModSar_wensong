AUTOSAR XML (schema 00049)
package /RB/Pt/VehFct/DrvDemDet/DetnPedl/Interfaces/V1_0_0
  service interface Svi_Demo
    namespaces:
      5 x symbol props:
        rb_1: symbol=rb
        pt_2: symbol=pt
        vehfct_3: symbol=vehfct
        drvdemdet_4: symbol=drvdemdet
        detnpedl_5: symbol=detnpedl
    field Fld_Arg: type=uint32_t, has-getter=true, has-notifier=true, has-setter=true
