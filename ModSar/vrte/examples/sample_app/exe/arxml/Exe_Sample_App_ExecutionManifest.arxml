AUTOSAR XML (schema 00050)
package /RB/VRTE/W3/Executables
  executable Exe_Sample_App: reporting-behavior=DOES-NOT-REPORT-EXECUTION-STATE
package /RB/VRTE/W3/Processes
  process Proc_Exe_Sample_App: executable=Exe_Sample_App, state-dependent-startup-config{function-group-state=DefaultFG.On, startup-config=Proc_Exe_Sample_App_StartupConfig}
package /RB/VRTE/W3/StartupConfigs
  startup config Proc_Exe_Sample_App_StartupConfig: scheduling-policy=SCHED_RR, termination-behavior=PROCESS-IS-SELF-TERMINATING, timeout={enter-timeout-value=1.0, exit-timeout-value=1.0}
    environment-variables:
      key=LD_LIBRARY_PATH, value=/opt/vrte/lib:/usr/lib:/lib:/proc/boot:/opt/vrte/usr/lib
      key=ECUCFG_ENV_VAR_ROOTFOLDER, value=/opt/app/etc/ecu-cfg
package /RB/VRTE/W3/ProcessToMachineMappings
  process to machine mapping set Exe_Sample_App_ExecutionManifest_ProcessToMachineMappingSet
    process to machine mapping Proc_Exe_Sample_App_FlexibleSafety_Mapping: machine=FlexibleSafety, process=Proc_Exe_Sample_App
package /RB/VRTE/W3/DltLogSinkToPortPrototypeMappings
  dlt log sink to port prototype mapping Exe_Sample_App_DLTLogChannel_Proc_Exe_Sample_App_dltMapping: dlt-context=Dlt_Dummy_Context, dlt-log-sink=Exe_Sample_App_DLTLogChannel, process=Proc_Exe_Sample_App
